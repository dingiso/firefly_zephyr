## boards/arm/cordyceps/Kconfig.defconfig
```kconfig
if BOARD_CORDYCEPS

config BOARD
	default "cordyceps"

config BT_CTLR
	default BT

endif # BOARD_CORDYCEPS
```

## boards/arm/firefly_v1/Kconfig.defconfig
```kconfig
if BOARD_FIREFLY_V1

config BOARD
	default "firefly_v1"

config BT_CTLR
	default BT

endif # BOARD_FIREFLY_V1
```

## boards/arm/lock_v01/Kconfig.defconfig
```kconfig
if BOARD_LOCK_V01

config BOARD
	default "lock_v01"

config BT_CTLR
	default BT

endif # BOARD_LOCK_V01
```

## boards/arm/locket/locket_defconfig
```kconfig
CONFIG_SOC_SERIES_STM32L1X=y
CONFIG_SOC_STM32L151XB=y
CONFIG_CORTEX_M_SYSTICK=y

# enable uart driver
CONFIG_SERIAL=y

# enable console
CONFIG_LOG=y
CONFIG_CONSOLE=y
CONFIG_UART_CONSOLE=y

# enable GPIO
CONFIG_GPIO=y

# clock configuration
CONFIG_CLOCK_CONTROL=y

# Enable SPI to be able to communicate to the radio chip (cc1101).
CONFIG_SPI=y
CONFIG_SPI_STM32_USE_HW_SS=n

CONFIG_EEPROM=y

CONFIG_PWM=y

# enable pin controller
CONFIG_PINCTRL=y
```

## boards/arm/power_meter/Kconfig.defconfig
```kconfig
if BOARD_POWER_METER

config BOARD
	default "power_meter_v1"

config BT_CTLR
	default BT

endif # BOARD_POWER_METER
```
